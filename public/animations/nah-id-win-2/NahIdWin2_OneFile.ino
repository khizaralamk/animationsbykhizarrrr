// NAH, I'D WIN 2 (everything in one file) for an ESP32 + 0.96" OLED (128 x 64, I2C)
// Wiring: OLED VCC -> 3V3, GND -> GND, SDA -> G25, SCL -> G26
//
// Shows the head and the "Nah, I'd win." speech bubble from nah_id_win_2.html. The picture stays
// still and every few seconds a shine slides across it. Inside the shine the
// drawing flips (lit turns dark, dark turns lit), which reads as a glare.
// Needs the Adafruit SSD1306 and Adafruit GFX libraries (Library Manager).

#include <Wire.h>
#include <Adafruit_GFX.h>
#include <Adafruit_SSD1306.h>
// The traced pictures are at the very bottom of this file.
// These lines tell the compiler about them before they are used.
const int FITTED_W = 128;
const int FITTED_H = 64;
const int ORIGINAL_W = 128;
const int ORIGINAL_H = 64;
extern const unsigned char FITTED_LINE[1024];
extern const unsigned char FITTED_FILL[1024];
extern const unsigned char FITTED_SHAPE[1024];
extern const unsigned char ORIGINAL_LINE[1024];
extern const unsigned char ORIGINAL_FILL[1024];
extern const unsigned char ORIGINAL_SHAPE[1024];

const int SDA_PIN = 25;
const int SCL_PIN = 26;

const int SCREEN_W = 128;
const int SCREEN_H = 64;

// ----- settings you can change -----
const bool FITTED = true;          // true = head and bubble each as big as the screen allows. false = the drawing's own arrangement
const bool FILL = true;            // true = Fill (head and bubble lit, blindfold and letters dark). false = Line (only the line work lit)
const int FRAMES_PER_SECOND = 30;  // same as the page
const int SHINE_FRAMES = 22;       // how many frames the shine takes to cross the screen
const int REST_FRAMES = 75;        // still frames between two shines
const int SHINE_WIDTH = 4;         // the wide stripe, in pixels
const int SHINE_GAP = 3;           // gap before the thin second stripe
const float SHINE_SLANT = 0.5;     // how much the stripes lean

Adafruit_SSD1306 display(SCREEN_W, SCREEN_H, &Wire, -1);
int foundAddr = 0;

// The picture in use, picked in setup() from the settings above.
const unsigned char* picture = nullptr;   // what is lit when nothing is shining
const unsigned char* shape = nullptr;     // which pixels belong to the drawing
int picW = 0, picH = 0;

int frame = 0;
unsigned long lastFrameAt = 0;

// ---------------------------------------------------------------------
// Small helpers
// ---------------------------------------------------------------------
// Is pixel (x, y) set in a stored picture? Rows are whole bytes, leftmost pixel = top bit.
bool storedPixel(const unsigned char* pic, int x, int y) {
  int bytesPerRow = (picW + 7) / 8;
  return pgm_read_byte(pic + y * bytesPerRow + (x >> 3)) & (0x80 >> (x & 7));
}

// Draws the still picture, plus the shine if frame f is one of the shine frames.
void drawFrame(int f) {
  display.clearDisplay();
  display.drawBitmap(0, 0, picture, picW, picH, SSD1306_WHITE);
  if (f < SHINE_FRAMES) {
    float travel = picW + picH * SHINE_SLANT + 16;
    float front = -8 + travel * ((float)f / SHINE_FRAMES);
    for (int y = 0; y < picH; y++) {
      for (int x = 0; x < picW; x++) {
        float behind = front - (x + (picH - 1 - y) * SHINE_SLANT);
        bool wide = behind >= 0 && behind < SHINE_WIDTH;
        bool thin = behind >= SHINE_WIDTH + SHINE_GAP && behind < SHINE_WIDTH + SHINE_GAP + 1;
        if ((wide || thin) && storedPixel(shape, x, y)) display.drawPixel(x, y, SSD1306_INVERSE);   // flip this pixel
      }
    }
  }
  display.display();
}

// Counts the lit pixels in the still picture (printed once at start-up as a self check).
int litPixels() {
  int lit = 0;
  for (int y = 0; y < picH; y++)
    for (int x = 0; x < picW; x++)
      if (storedPixel(picture, x, y)) lit++;
  return lit;
}

// ---------------------------------------------------------------------
// Setup and loop
// ---------------------------------------------------------------------
bool deviceAnswers(int addr) {
  Wire.beginTransmission(addr);
  return Wire.endTransmission() == 0;
}

void oledCommand(uint8_t c) {
  Wire.beginTransmission(foundAddr);
  Wire.write(0x00);
  Wire.write(c);
  Wire.endTransmission();
}

void setup() {
  Serial.begin(115200);
  delay(500);
  Serial.println("\n===== NAH, I'D WIN 2 =====");

  Wire.begin(SDA_PIN, SCL_PIN, 100000);
  delay(50);
  for (int tries = 0; tries < 20 && foundAddr == 0; tries++) {   // this board often misses the first probe
    if (deviceAnswers(0x3C))      foundAddr = 0x3C;
    else if (deviceAnswers(0x3D)) foundAddr = 0x3D;
    else delay(30);
  }
  if (foundAddr == 0) {
    Serial.println("OLED NOT found on SDA=G25 SCL=G26. Check the 4 wires.");
    while (true) delay(1000);
  }
  Serial.printf("OLED found at 0x%02X\n", foundAddr);

  // Wake-up sequence this panel needs before the driver takes over.
  oledCommand(0xAE);
  oledCommand(0x8D); oledCommand(0x14);
  oledCommand(0xAD); oledCommand(0x8B);
  oledCommand(0xAF);
  delay(100);

  if (!display.begin(SSD1306_SWITCHCAPVCC, foundAddr)) {
    Serial.println("display.begin() failed.");
    while (true) delay(1000);
  }

  // Pick the picture for the chosen layout and style.
  if (FITTED) {
    picW = FITTED_W; picH = FITTED_H;
    picture = FILL ? FITTED_FILL : FITTED_LINE;
    shape = FITTED_SHAPE;
  } else {
    picW = ORIGINAL_W; picH = ORIGINAL_H;
    picture = FILL ? ORIGINAL_FILL : ORIGINAL_LINE;
    shape = ORIGINAL_SHAPE;
  }
  Serial.printf("%s, %s style, %d x %d, %d pixels lit\n", FITTED ? "Fitted" : "Original", FILL ? "fill" : "line", picW, picH, litPixels());

  drawFrame(SHINE_FRAMES);                                       // the still picture
  lastFrameAt = millis();
  Serial.println("Ready. The shine runs every few seconds.");
}

void loop() {
  unsigned long now = millis();
  if (now - lastFrameAt < (unsigned long)(1000 / FRAMES_PER_SECOND)) { delay(2); return; }
  lastFrameAt = now;

  frame = (frame + 1) % (SHINE_FRAMES + REST_FRAMES);
  if (frame == 0) Serial.println("Shine");
  // Only the shine frames, and the first still frame after them, need drawing.
  if (frame <= SHINE_FRAMES) drawFrame(frame);
}

// =====================================================================
// THE TRACED PICTURES
// 1 bit per pixel, leftmost pixel = top bit. LINE and FILL are the two styles,
// SHAPE marks every pixel of the drawing (the shine only flips pixels inside it).
// =====================================================================
const unsigned char FITTED_LINE[1024] PROGMEM = {
  0x00, 0x00, 0x00, 0x00, 0x00, 0x00, 0x00, 0x00, 0x00, 0x00, 0x00, 0x3f, 0xff, 0xf0, 0x00, 0x00,
  0x00, 0x00, 0x00, 0x02, 0x00, 0x80, 0x00, 0x00, 0x00, 0x00, 0x03, 0xfe, 0x07, 0xff, 0xe0, 0x00,
  0x00, 0x00, 0x00, 0x03, 0x00, 0xc0, 0x00, 0x00, 0x00, 0x00, 0x06, 0x00, 0x00, 0x01, 0xf8, 0x00,
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  0x00, 0x00, 0x00, 0x00, 0x00, 0x00, 0x00, 0x00, 0x00, 0x08, 0x00, 0x00, 0x3f, 0x00, 0x00, 0x00,
};
const unsigned char FITTED_FILL[1024] PROGMEM = {
  0x00, 0x00, 0x00, 0x00, 0x00, 0x00, 0x00, 0x00, 0x00, 0x00, 0x00, 0x3f, 0xff, 0xf0, 0x00, 0x00,
  0x00, 0x00, 0x00, 0x02, 0x00, 0x80, 0x00, 0x00, 0x00, 0x00, 0x03, 0xff, 0xff, 0xff, 0xe0, 0x00,
  0x00, 0x00, 0x00, 0x03, 0x00, 0xc0, 0x00, 0x00, 0x00, 0x00, 0x07, 0xff, 0xff, 0xff, 0xf8, 0x00,
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  0x00, 0x00, 0x00, 0x00, 0x00, 0x0f, 0xf8, 0x00, 0x00, 0x08, 0x00, 0x00, 0x3f, 0x00, 0x00, 0x00,
};
const unsigned char FITTED_SHAPE[1024] PROGMEM = {
  0x00, 0x00, 0x00, 0x00, 0x00, 0x00, 0x00, 0x00, 0x00, 0x00, 0x00, 0x3f, 0xff, 0xf0, 0x00, 0x00,
  0x00, 0x00, 0x00, 0x02, 0x00, 0x80, 0x00, 0x00, 0x00, 0x00, 0x03, 0xff, 0xff, 0xff, 0xe0, 0x00,
  0x00, 0x00, 0x00, 0x03, 0x00, 0xc0, 0x00, 0x00, 0x00, 0x00, 0x07, 0xff, 0xff, 0xff, 0xf8, 0x00,
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  0x00, 0x00, 0x00, 0x00, 0x00, 0x0f, 0xf8, 0x00, 0x00, 0x08, 0x00, 0x00, 0x3f, 0x00, 0x00, 0x00,
};

const unsigned char ORIGINAL_LINE[1024] PROGMEM = {
  0x00, 0x00, 0x00, 0x00, 0x00, 0x00, 0x00, 0x00, 0x00, 0x00, 0x00, 0x00, 0x00, 0x00, 0x00, 0x00,
  0x00, 0x00, 0x00, 0x00, 0x00, 0x00, 0x00, 0x00, 0x00, 0x00, 0xff, 0xff, 0x00, 0x00, 0x00, 0x00,
  0x00, 0x00, 0x00, 0x00, 0x00, 0x00, 0x00, 0x00, 0x00, 0x00, 0x80, 0x01, 0xf0, 0x00, 0x00, 0x00,
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  0x00, 0x00, 0x00, 0x00, 0x00, 0x00, 0x00, 0x00, 0x00, 0x00, 0x00, 0x00, 0x00, 0x00, 0x00, 0x00,
};
const unsigned char ORIGINAL_FILL[1024] PROGMEM = {
  0x00, 0x00, 0x00, 0x00, 0x00, 0x00, 0x00, 0x00, 0x00, 0x00, 0x00, 0x00, 0x00, 0x00, 0x00, 0x00,
  0x00, 0x00, 0x00, 0x00, 0x00, 0x00, 0x00, 0x00, 0x00, 0x00, 0xff, 0xff, 0x00, 0x00, 0x00, 0x00,
  0x00, 0x00, 0x00, 0x00, 0x00, 0x00, 0x00, 0x00, 0x00, 0x00, 0xff, 0xff, 0xf0, 0x00, 0x00, 0x00,
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  0x00, 0x00, 0x00, 0x00, 0x00, 0x00, 0x01, 0xff, 0x00, 0x00, 0x00, 0x00, 0x00, 0x00, 0x00, 0x00,
};
const unsigned char ORIGINAL_SHAPE[1024] PROGMEM = {
  0x00, 0x00, 0x00, 0x00, 0x00, 0x00, 0x00, 0x00, 0x00, 0x00, 0x00, 0x00, 0x00, 0x00, 0x00, 0x00,
  0x00, 0x00, 0x00, 0x00, 0x00, 0x00, 0x00, 0x00, 0x00, 0x00, 0xff, 0xff, 0x00, 0x00, 0x00, 0x00,
  0x00, 0x00, 0x00, 0x00, 0x00, 0x00, 0x00, 0x00, 0x00, 0x00, 0xff, 0xff, 0xf0, 0x00, 0x00, 0x00,
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  0x00, 0x00, 0x00, 0x00, 0x00, 0x00, 0x01, 0xff, 0x00, 0x00, 0x00, 0x00, 0x00, 0x00, 0x00, 0x00,
};
