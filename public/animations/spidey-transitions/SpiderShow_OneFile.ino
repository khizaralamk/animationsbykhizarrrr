// SPIDER SHOW (everything in one file) for an ESP32 + 0.96" OLED (128 x 64, I2C)
// Wiring: OLED VCC -> 3V3, GND -> GND, SDA -> G25, SCL -> G26
//
// Shows three spider emblems one after another (Curved legs, Angular legs,
// Long legs) with a glitch effect between them, then starts again.
// It is the "Glitch show" from the preview page spidey-transitions.html.
//
// The numbers under "settings you can change" are the ones from the preview page.
// Change a number, upload again, and the board follows.
// Needs the Adafruit SSD1306 and Adafruit GFX libraries (Library Manager).

#include <Wire.h>
#include <Adafruit_GFX.h>
#include <Adafruit_SSD1306.h>
// The three spider pictures (256 x 256 each) are at the very bottom of this file.
// These three lines tell the compiler they exist before they are used.
extern const uint8_t SPIDER_CURVED[8192];
extern const uint8_t SPIDER_ANGULAR[8192];
extern const uint8_t SPIDER_LONG[8192];

const int SDA_PIN = 25;
const int SCL_PIN = 26;

const int SCREEN_W = 128;
const int SCREEN_H = 64;

// ----- settings you can change -----
const int SPIDER_SIZE  = 48;       // longest side of the spider in screen pixels ("Size" on the page)
const int SPIDER_ANGLE = 0;        // 0 = upright, 90 = head points right, 180 = upside down ("Angle")
const int LINE_WEIGHT  = 7;        // 1 = thinnest legs, 10 = boldest ("Line weight")
const int CENTRE_X     = 64;       // where the middle of the spider sits on the screen
const int CENTRE_Y     = 32;       // 32 = middle of the whole screen, 40 = middle of the cyan part
const int HOLD_MS      = 1000;     // how long each spider stays on screen ("Show each spider for")
const int GLITCH_MS    = 720;      // how long one glitch takes. Smaller = faster ("Transition speed")
const int FRAME_MS     = 42;       // one glitch frame every 42 ms = 24 frames a second, like the page

// ----- facts about the spider pictures in spider_masters.h -----
const int MASTER_SIZE  = 256;      // each big picture is 256 x 256
const int MASTER_SPAN  = 240;      // the spider's longest side covers 240 of those pixels
const int SAMPLES      = 4;        // 4 x 4 = 16 look-ups per screen pixel
const int SPIDER_COUNT = 3;
const uint8_t* const MASTERS[SPIDER_COUNT] = { SPIDER_CURVED, SPIDER_ANGULAR, SPIDER_LONG };
const char* const SPIDER_NAMES[SPIDER_COUNT] = { "Curved legs", "Angular legs", "Long legs" };

Adafruit_SSD1306 display(SCREEN_W, SCREEN_H, &Wire, -1);
int foundAddr = 0;

// Screen-sized pictures: row by row, 16 bytes per row, leftmost pixel = top bit (same as drawBitmap).
// Pixel number i = y * 128 + x.
const int PIC_BYTES = SCREEN_W * SCREEN_H / 8;   // 1024 bytes per picture
uint8_t spiderPic[SPIDER_COUNT][PIC_BYTES];      // the three spiders, drawn once at start-up
uint8_t outPic[PIC_BYTES];                       // what goes on the screen during a glitch

int  current = 0;                  // the spider on screen now
int  next = 1;                     // the spider the glitch is changing to
bool glitching = false;
unsigned long stageStart = 0;      // when this hold or this glitch began

// ---------------------------------------------------------------------
// Small helpers
// ---------------------------------------------------------------------
bool getPixel(const uint8_t* pic, int i) { return pic[i >> 3] & (0x80 >> (i & 7)); }
void setPixel(uint8_t* pic, int i, bool on) {
  if (on) pic[i >> 3] |= (0x80 >> (i & 7));
  else    pic[i >> 3] &= ~(0x80 >> (i & 7));
}
int   roundLikePage(float v) { return (int)floorf(v + 0.5f); }
float rand01() { return random(0, 10000) / 10000.0f; }          // a random number from 0 to 1

// ---------------------------------------------------------------------
// Draws one spider into a screen-sized picture, at SPIDER_SIZE and SPIDER_ANGLE.
// For every screen pixel it looks back into the big picture at the turned spot,
// takes 16 samples, and lights the pixel when enough of them land on the spider.
// Returns how many pixels it lit. This is the same maths as the preview page.
// ---------------------------------------------------------------------
int renderSpider(const uint8_t* master, uint8_t* pic) {
  memset(pic, 0, PIC_BYTES);
  float k = (float)MASTER_SPAN / SPIDER_SIZE;                   // big-picture pixels per screen pixel
  float rad = SPIDER_ANGLE * PI / 180.0f;
  float c = cosf(rad), s = sinf(rad);
  int need = 11 - LINE_WEIGHT;                                  // weight 1..10 -> 10..1 of the 16 samples must hit
  int lit = 0;
  for (int y = 0; y < SCREEN_H; y++) {
    for (int x = 0; x < SCREEN_W; x++) {
      int hits = 0;
      for (int j = 0; j < SAMPLES; j++) {
        float dy = y + (j + 0.5f) / SAMPLES - CENTRE_Y;
        for (int i = 0; i < SAMPLES; i++) {
          float dx = x + (i + 0.5f) / SAMPLES - CENTRE_X;
          int u = (int)floorf(( dx * c + dy * s) * k + MASTER_SIZE / 2);
          int v = (int)floorf((-dx * s + dy * c) * k + MASTER_SIZE / 2);
          if (u >= 0 && u < MASTER_SIZE && v >= 0 && v < MASTER_SIZE &&
              (pgm_read_byte(master + v * (MASTER_SIZE / 8) + (u >> 3)) & (0x80 >> (u & 7)))) hits++;
        }
      }
      if (hits >= need) { setPixel(pic, y * SCREEN_W + x, true); lit++; }
    }
  }
  return lit;
}

// ---------------------------------------------------------------------
// The glitch: mixes picture A (old spider) and picture B (new spider) into outPic.
// u goes from 0 to 1 over the glitch. Same effect as the anime logo deck.
// ---------------------------------------------------------------------
void glitch(const uint8_t* A, const uint8_t* B, float u, unsigned long t) {
  // 0-.35 old spider tears apart, .35-.65 both fight in bands, .65-1 new spider settles
  const uint8_t* src = u < 0.35f ? A : u > 0.65f ? B : nullptr;
  float heat = u < 0.35f ? u / 0.35f : u > 0.65f ? (1 - u) / 0.35f : 1;
  for (int y = 0; y < SCREEN_H; y++) {
    int band = (y >> 2) + (int)(rand01() * 3);
    const uint8_t* from = src ? src : (((band + (int)(t / 42)) & 1) ? B : A);
    int tear = rand01() < 0.18f * heat ? roundLikePage((rand01() - 0.5f) * 30 * heat) : 0;
    bool invert = !src && rand01() < 0.06f;
    for (int x = 0; x < SCREEN_W; x++) {
      bool v = getPixel(from, y * SCREEN_W + ((x - tear + SCREEN_W) % SCREEN_W));
      if (invert) v = !v;
      setPixel(outPic, y * SCREEN_W + x, v);
    }
  }
  // block noise and a rolling bright bar
  int blocks = roundLikePage(6 * heat);
  for (int n = 0; n < blocks; n++) {
    int bx = (int)(rand01() * SCREEN_W), by = (int)(rand01() * SCREEN_H);
    int bw = (int)(3 + rand01() * 14), bh = (int)(1 + rand01() * 3);
    for (int y = by; y < min(SCREEN_H, by + bh); y++)
      for (int x = bx; x < min(SCREEN_W, bx + bw); x++)
        setPixel(outPic, y * SCREEN_W + x, rand01() < 0.5f);
  }
  if (heat > 0.5f) {
    int ry = (int)(t / 12) % SCREEN_H;
    for (int x = 0; x < SCREEN_W; x++)
      if ((x + ry) % 3) setPixel(outPic, ry * SCREEN_W + x, !getPixel(outPic, ry * SCREEN_W + x));
  }
}

// Puts one screen-sized picture on the OLED.
void showPicture(uint8_t* pic) {
  display.clearDisplay();
  display.drawBitmap(0, 0, pic, SCREEN_W, SCREEN_H, SSD1306_WHITE);
  display.display();
}

// ---------------------------------------------------------------------
// Setup and loop
// ---------------------------------------------------------------------
bool deviceAnswers(int addr) {
  Wire.beginTransmission(addr);
  return Wire.endTransmission() == 0;
}

void oledCommand(uint8_t c) {
  Wire.beginTransmission(foundAddr);
  Wire.write(0x00);
  Wire.write(c);
  Wire.endTransmission();
}

void setup() {
  Serial.begin(115200);
  delay(500);
  Serial.println("\n===== SPIDER SHOW =====");

  Wire.begin(SDA_PIN, SCL_PIN, 100000);
  delay(50);
  for (int tries = 0; tries < 20 && foundAddr == 0; tries++) {   // this board often misses the first probe
    if (deviceAnswers(0x3C))      foundAddr = 0x3C;
    else if (deviceAnswers(0x3D)) foundAddr = 0x3D;
    else delay(30);
  }
  if (foundAddr == 0) {
    Serial.println("OLED NOT found on SDA=G25 SCL=G26. Check the 4 wires.");
    while (true) delay(1000);
  }
  Serial.printf("OLED found at 0x%02X\n", foundAddr);

  // Wake-up sequence this panel needs before the driver takes over.
  oledCommand(0xAE);
  oledCommand(0x8D); oledCommand(0x14);
  oledCommand(0xAD); oledCommand(0x8B);
  oledCommand(0xAF);
  delay(100);

  if (!display.begin(SSD1306_SWITCHCAPVCC, foundAddr)) {
    Serial.println("display.begin() failed.");
    while (true) delay(1000);
  }

  // Draw the three spiders once. After this the loop only swaps and glitches pictures.
  for (int n = 0; n < SPIDER_COUNT; n++) {
    int lit = renderSpider(MASTERS[n], spiderPic[n]);
    Serial.printf("%s: %d pixels lit\n", SPIDER_NAMES[n], lit);
  }

  randomSeed(micros());
  showPicture(spiderPic[current]);
  stageStart = millis();
  Serial.println("Ready. The show is running.");
}

void loop() {
  unsigned long now = millis();

  if (!glitching) {
    // holding one spider still: wait until its time is up, then start a glitch to the next one
    if (now - stageStart >= (unsigned long)HOLD_MS) {
      next = (current + 1) % SPIDER_COUNT;
      glitching = true;
      stageStart = now;
    } else {
      delay(5);
    }
    return;
  }

  float u = (float)(now - stageStart) / GLITCH_MS;
  if (u >= 1) {                                                  // glitch finished: the new spider stays
    current = next;
    glitching = false;
    stageStart = now;
    showPicture(spiderPic[current]);
    Serial.printf("Now showing: %s\n", SPIDER_NAMES[current]);
    return;
  }

  glitch(spiderPic[current], spiderPic[next], u, now - stageStart);
  showPicture(outPic);

  unsigned long took = millis() - now;                           // keep the glitch at 24 frames a second
  if (took < (unsigned long)FRAME_MS) delay(FRAME_MS - took);
}

// =====================================================================
// THE THREE SPIDER PICTURES
// Each one is 256 x 256 pixels, 1 bit per pixel, 32 bytes per row, leftmost pixel = top bit.
// The spider's longest side covers 240 of the 256 pixels and its middle is the middle of the picture.
// Made by the Spidey Transitions page from the same data it draws with. Do not edit by hand.
// =====================================================================

const uint8_t SPIDER_CURVED[8192] PROGMEM = {  // Curved legs
  0x00,0x00,0x00,0x00,0x00,0x00,0x00,0x00,0x00,0x00,0x00,0x00,0x00,0x00,0x00,0x00,0x00,0x00,0x00,0x00,0x00,0x00,0x00,0x00,0x00,0x00,0x00,0x00,0x00,0x00,0x00,0x00,
  0x00,0x00,0x00,0x00,0x00,0x00,0x00,0x00,0x00,0x00,0x00,0x00,0x00,0x00,0x00,0x00,0x00,0x00,0x00,0x00,0x00,0x00,0x00,0x00,0x00,0x00,0x00,0x00,0x00,0x00,0x00,0x00,
  0x00,0x00,0x00,0x00,0x00,0x00,0x00,0x00,0x00,0x00,0x00,0x00,0x00,0x00,0x00,0x00,0x00,0x00,0x00,0x00,0x00,0x00,0x00,0x00,0x00,0x00,0x00,0x00,0x00,0x00,0x00,0x00,
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  0x00,0x00,0x00,0x00,0x00,0x00,0x00,0x00,0x00,0x00,0x00,0x00,0x00,0x00,0x00,0x00,0x00,0x00,0x00,0x00,0x00,0x00,0x00,0x00,0x00,0x00,0x00,0x00,0x00,0x00,0x00,0x00,
};

const uint8_t SPIDER_ANGULAR[8192] PROGMEM = {  // Angular legs
  0x00,0x00,0x00,0x00,0x00,0x00,0x00,0x00,0x00,0x00,0x00,0x00,0x00,0x00,0x00,0x00,0x00,0x00,0x00,0x00,0x00,0x00,0x00,0x00,0x00,0x00,0x00,0x00,0x00,0x00,0x00,0x00,
  0x00,0x00,0x00,0x00,0x00,0x00,0x00,0x00,0x00,0x00,0x00,0x00,0x00,0x00,0x00,0x00,0x00,0x00,0x00,0x00,0x00,0x00,0x00,0x00,0x00,0x00,0x00,0x00,0x00,0x00,0x00,0x00,
  0x00,0x00,0x00,0x00,0x00,0x00,0x00,0x00,0x00,0x00,0x00,0x00,0x00,0x00,0x00,0x00,0x00,0x00,0x00,0x00,0x00,0x00,0x00,0x00,0x00,0x00,0x00,0x00,0x00,0x00,0x00,0x00,
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  0x00,0x00,0x00,0x00,0x00,0x00,0x00,0x00,0x00,0x00,0x00,0x00,0x00,0x00,0x00,0x00,0x00,0x00,0x00,0x00,0x00,0x00,0x00,0x00,0x00,0x00,0x00,0x00,0x00,0x00,0x00,0x00,
};

const uint8_t SPIDER_LONG[8192] PROGMEM = {  // Long legs
  0x00,0x00,0x00,0x00,0x00,0x00,0x00,0x00,0x00,0x00,0x00,0x00,0x00,0x00,0x00,0x00,0x00,0x00,0x00,0x00,0x00,0x00,0x00,0x00,0x00,0x00,0x00,0x00,0x00,0x00,0x00,0x00,
  0x00,0x00,0x00,0x00,0x00,0x00,0x00,0x00,0x00,0x00,0x00,0x00,0x00,0x00,0x00,0x00,0x00,0x00,0x00,0x00,0x00,0x00,0x00,0x00,0x00,0x00,0x00,0x00,0x00,0x00,0x00,0x00,
  0x00,0x00,0x00,0x00,0x00,0x00,0x00,0x00,0x00,0x00,0x00,0x00,0x00,0x00,0x00,0x00,0x00,0x00,0x00,0x00,0x00,0x00,0x00,0x00,0x00,0x00,0x00,0x00,0x00,0x00,0x00,0x00,
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  0x00,0x00,0x00,0x00,0x00,0x00,0x00,0x00,0x00,0x00,0x00,0x00,0x00,0x00,0x00,0x00,0x00,0x00,0x00,0x00,0x00,0x00,0x00,0x00,0x00,0x00,0x00,0x00,0x00,0x00,0x00,0x00,
};

